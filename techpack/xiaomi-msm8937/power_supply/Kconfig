## techpack/xiaomi-msm8937/power_supply/Kconfig
```kconfig
menu "Power supply"
	depends on POWER_SUPPLY

source "techpack/xiaomi-msm8937/power_supply/bq2560x/Kconfig"
source "techpack/xiaomi-msm8937/power_supply/bq27426/Kconfig"
source "techpack/xiaomi-msm8937/power_supply/cw2015_rolex/Kconfig"
source "techpack/xiaomi-msm8937/power_supply/cw2017_tiare/Kconfig"
source "techpack/xiaomi-msm8937/power_supply/qcom/Kconfig"
source "techpack/xiaomi-msm8937/power_supply/smb358_rolex/Kconfig"

endmenu
```
